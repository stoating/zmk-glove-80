//        Mapping
// DEU | ENG       | NAME
//  y  |  z        | z
#define de_y         Z
//  z  |  y        | y
#define de_z         Y

//  ä  |  '        | SQT
#define m_de_ael     SQT
//  Ä  |  "        | DQT
#define m_de_aeu     DQT
//  ö  |  ;        | SEMI
#define m_de_oel     SEMI
//  Ö  |  :        | COLON
#define m_de_oeu     COLON
//  ü  |  [        | LBKT
#define m_de_uel     LBKT
//  Ü  |  {        | LBRC
#define m_de_ueu     LBRC
//  ß  |  -        | MINUS
#define de_sz        MINUS

//  ^  |  `        | GRAVE
#define de_carat     GRAVE
//  °  |  ~        | TILDE
#define de_deg       TILDE
//  !  |  !        | EXCL
#define de_excl      EXCL
//  "  |  @        | AT
#define de_dqt       AT
//  ²  |  alt+235  | alt+0178
#define m_de_ss_tw   &kp KP_N0 &kp KP_N1 &kp KP_N7 &kp KP_N8
//  ³  |  alt+0179 | alt+0179
#define m_de_ss_tr   &kp KP_N0 &kp KP_N1 &kp KP_N7 &kp KP_N9
//  §  |  #        | HASH
#define de_sect      HASH
//  $  |  $        | DLLR
#define de_dllr      DLLR
//  %  |  %        | PRCNT
#define de_prcnt     PRCNT
//  &  |  ^        | CARET
#define de_amps      CARET
//  /  |  &        | AMPS
#define de_fslh      AMPS
//  {  |  alt+123  | alt+123
#define m_de_lbrc    &kp KP_N1 &kp KP_N2 &kp KP_N3
//  (  |  *        | STAR
#define de_lpar      STAR
//  [  |  alt+91   | alt+91
#define m_de_lbkt    &kp KP_N9 &kp KP_N1
//  )  |  (        | LPAR
#define de_rpar      LPAR
//  ]  |  alt+93   | alt+93
#define m_de_rbkt    &kp KP_N9 &kp KP_N3
//  =  |  )        | RPAR
#define de_equal     RPAR
//  }  |  alt+125  | alt+125
#define m_de_rbrc    &kp KP_N1 &kp KP_N2 &kp KP_N5
//  ?  |  _        | UNDER
#define de_qmark     UNDER
//  \  |  alt+92   | alt+92
#define m_de_bslh    &kp KP_N9 &kp KP_N2
//  ´  |  =        | EQUAL
#define de_btick     EQUAL
//  `  |  +        | PLUS
#define de_tick      PLUS
//  @  |  alt+64   | alt+64
#define m_de_at      &kp KP_N6 &kp KP_N4
//  €  |  alt+0128  | alt+0128
#define m_de_euro    &kp KP_N0 &kp KP_N1 &kp KP_N2 &kp KP_N8
//  +  |  ]        | RBKT
#define de_plus      RBKT
//  *  |  }        | RBRC
#define de_star      RBRC
//  ~  |  alt+126  | alt+126
#define m_de_tilde   &kp KP_N1 &kp KP_N2 &kp KP_N6
//  #  |  \        | BSLH
#define de_hash      BSLH
//  '  |  |        | PIPE
#define de_sqt       PIPE
//  <  |  \        | alt+60
#define m_de_lt      &kp KP_N6 &kp KP_N0
//  >  |  |        | alt+62
#define m_de_gt      &kp KP_N6 &kp KP_N2
//  |  |  alt+124  | alt+124
#define m_de_pipe    &kp KP_N1 &kp KP_N2 &kp KP_N4
//  µ  |  alt+230  | alt+230
#define m_de_micro   &kp KP_N2 &kp KP_N3 &kp KP_N0
//  ,  |  ,        | COMMA
#define de_comma     COMMA
//  ;  |  <        | LT
#define de_semi      LT
//  .  |  .        | DOT
#define de_dot       DOT
//  :  |  >        | GT
#define de_colon     GT
//  -  |  /        | FSLH
#define de_minus     FSLH
//  _  |  ?        | QMARK
#define de_under     QMARK

#define ZMK_HELPER_STRINGIFY(x) #x
#define PRESS_ALT &macro_press &kp LALT
#define RELEASE_ALT &macro_release &kp LALT

#define SINGLE_KEY_MACRO(name, key_binding) \
    macros { \
        name: name { \
            compatible = "zmk,behavior-macro"; \
            label = ZMK_HELPER_STRINGIFY(SINGLE_KEY_MACRO_ ## name); \
            #binding-cells = <0>; \
            wait-ms = <0>; \
            tap-ms = <0>; \
            bindings = <&macro_tap &kp key_binding>; \
        }; \
    };

#define ALT_MACRO(name, alt_code_bindings) \
    macros { \
        name: name { \
            compatible = "zmk,behavior-macro"; \
            label = ZMK_HELPER_STRINGIFY(ALT_MACRO_ ## name); \
            #binding-cells = <0>; \
            wait-ms = <30>; \
            tap-ms = <40>; \
            bindings = <PRESS_ALT> \
                     , <&macro_tap alt_code_bindings> \
                     , <RELEASE_ALT>; \
        }; \
    };

#define STD_MACRO(name, key_bindings) \
    macros { \
        name: name { \
            compatible = "zmk,behavior-macro"; \
            label = ZMK_HELPER_STRINGIFY(STD_MACRO_ ## name); \
            #binding-cells = <0>; \
            wait-ms = <30>; \
            tap-ms = <40>; \
            bindings = <&macro_tap key_bindings>; \
        }; \
    };

#define MORPH_ON_SHIFT(name, key_binding, shifted_key_binding) \
    behaviors { \
        name: name { \
            compatible = "zmk,behavior-mod-morph"; \
            label = ZMK_HELPER_STRINGIFY(MORPH_ON_SHIFT_ ## name); \
            #binding-cells = <0>; \
            bindings = <key_binding> \
                     , <shifted_key_binding>; \
            mods = <(MOD_LSFT|MOD_RSFT)>; \
        }; \
    };

behaviors {
    ht: hold_tap {
        compatible = "zmk,behavior-hold-tap";
        label = "HOLD_TAP";
        #binding-cells = <2>;
        flavor = "balanced";
        tapping-term-ms = <177>;
        quick-tap-ms = <125>;
        bindings = <&kp>, <&kp>;
    };
    ht_at: ht_at {
        compatible = "zmk,behavior-hold-tap";
        label = "HOLD_TAP_at";
        #binding-cells = <2>;
        flavor = "tap-preferred";
        tapping-term-ms = <177>;
        quick-tap-ms = <125>;
        bindings = <&de_at>, <&kp>;
    };
    ht_euro: ht_euro {
        compatible = "zmk,behavior-hold-tap";
        label = "HOLD_TAP_euro";
        #binding-cells = <2>;
        flavor = "tap-preferred";
        tapping-term-ms = <177>;
        quick-tap-ms = <125>;
        bindings = <&de_euro>, <&kp>;
    };
    ht_tilde: ht_tilde {
        compatible = "zmk,behavior-hold-tap";
        label = "HOLD_TAP_tilde";
        #binding-cells = <2>;
        flavor = "tap-preferred";
        tapping-term-ms = <177>;
        quick-tap-ms = <125>;
        bindings = <&de_tilde>, <&kp>;
    };
    ht_ss_tw: ht_ss_tw {
        compatible = "zmk,behavior-hold-tap";
        label = "HOLD_TAP_ss_tw";
        #binding-cells = <2>;
        flavor = "tap-preferred";
        tapping-term-ms = <177>;
        quick-tap-ms = <125>;
        bindings = <&de_ss_tw>, <&kp>;
    };
    ht_ss_tr: ht_ss_tr {
        compatible = "zmk,behavior-hold-tap";
        label = "HOLD_TAP_ss_tr";
        #binding-cells = <2>;
        flavor = "tap-preferred";
        tapping-term-ms = <177>;
        quick-tap-ms = <125>;
        bindings = <&de_ss_tr>, <&kp>;
    };
    ht_micro: ht_micro {
        compatible = "zmk,behavior-hold-tap";
        label = "HOLD_TAP_micro";
        #binding-cells = <2>;
        flavor = "tap-preferred";
        tapping-term-ms = <177>;
        quick-tap-ms = <125>;
        bindings = <&de_micro>, <&de_micro>;
    };
};

#define TWO_KEY_COMBO1(key_binding, key1, key2, on_layer) \
    combos{ \
        compatible = "zmk,combos"; \
        combo_ ## key1 ## key2{ \
            timeout-ms = <75>; \
            key-positions = <key1 key2>; \
            layers = <on_layer>; \
            bindings = <&kp key_binding>; \
        }; \
    };

#define TWO_KEY_COMBO2(key_binding, key1, key2, on_layer) \
    combos{ \
        compatible = "zmk,combos"; \
        combo_ ## key1 ## key2{ \
            timeout-ms = <75>; \
            key-positions = <key1 key2>; \
            layers = <on_layer>; \
            bindings = <key_binding>; \
        }; \
    };

#define SHIFTABLE_PAIR(name, lower, upper) \
    SINGLE_KEY_MACRO(name ## _lower, lower) \
    SINGLE_KEY_MACRO(name ## _upper, upper) \
    MORPH_ON_SHIFT(name, &name ## _lower, &name ## _upper)

// umlauts
SHIFTABLE_PAIR(de_ae, m_de_ael, m_de_aeu)
SHIFTABLE_PAIR(de_oe, m_de_oel, m_de_oeu)
SHIFTABLE_PAIR(de_ue, m_de_uel, m_de_ueu)

// alt macros for eng --> deu non-existant mappings
ALT_MACRO(de_ss_tw, m_de_ss_tw)
ALT_MACRO(de_ss_tr, m_de_ss_tr)
ALT_MACRO(de_lbrc , m_de_lbrc)
ALT_MACRO(de_lbkt , m_de_lbkt)
ALT_MACRO(de_rbkt , m_de_rbkt)
ALT_MACRO(de_rbrc , m_de_rbrc)
ALT_MACRO(de_bslh , m_de_bslh)
ALT_MACRO(de_at   , m_de_at)
ALT_MACRO(de_euro , m_de_euro)
ALT_MACRO(de_tilde, m_de_tilde)
ALT_MACRO(de_lt   , m_de_lt)
ALT_MACRO(de_gt   , m_de_gt)
ALT_MACRO(de_pipe , m_de_pipe)
ALT_MACRO(de_micro, m_de_micro)

// parentheses
TWO_KEY_COMBO2(&de_lbrc, 15, 27, 0)
TWO_KEY_COMBO1(de_lpar , 27, 39, 0)
TWO_KEY_COMBO2(&de_lbkt, 39, 51, 0)
TWO_KEY_COMBO2(&de_rbrc, 16, 28, 0)
TWO_KEY_COMBO1(de_rpar , 28, 40, 0)
TWO_KEY_COMBO2(&de_rbkt, 40, 58, 0)

// slashes
TWO_KEY_COMBO1(de_fslh , 26, 38, 0)
TWO_KEY_COMBO2(&de_bslh, 29, 41, 0)

// logical operators
TWO_KEY_COMBO2(&de_pipe, 23, 35, 0)
TWO_KEY_COMBO1(de_amps , 24, 36, 0)
TWO_KEY_COMBO1(de_equal, 25, 37, 0)
TWO_KEY_COMBO2(&de_lt  , 35, 47, 0)
TWO_KEY_COMBO2(&de_gt  , 36, 48, 0)
TWO_KEY_COMBO1(de_excl , 37, 49, 0)

// anonymous function
TWO_KEY_COMBO1(de_hash, 38, 50, 0)

// math
TWO_KEY_COMBO1(de_star, 30, 42, 0)
TWO_KEY_COMBO1(de_plus, 42, 60, 0)
TWO_KEY_COMBO2(&de_bslh, 31, 43, 0)
TWO_KEY_COMBO1(de_minus, 43, 61, 0)

// multi-input macros
STD_MACRO(save_all , &kp LC(K) &kp S)
STD_MACRO(sel_left , &kp RIGHT_SHIFT &kp HOME)
STD_MACRO(sel_right, &kp RIGHT_SHIFT &kp END)
STD_MACRO(sel_row  , &kp HOME &kp RIGHT_SHIFT &kp END)

// s-expression manipulation
STD_MACRO(wrap_map , &kp LA(LC(R)) &kp LA(LC(H)))
STD_MACRO(wrap_set , &kp LA(LC(R)) &kp LA(LC(C)))
STD_MACRO(wrap_list, &kp LA(LC(R)) &kp LA(LC(P)))
STD_MACRO(wrap_vec , &kp LA(LC(R)) &kp LA(LC(S)))
STD_MACRO(wrap_str , &kp LA(LC(R)) &kp LA(LC(Q)))